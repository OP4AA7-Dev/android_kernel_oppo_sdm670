## drivers/platform/oplus/Kconfig
```kconfig
# OPlus configuration options

config MACH_OPLUS
	bool "OPlus device"
	depends on ARCH_QCOM
	help
	  Support for OPlus products

config MACH_OPLUS_SDM710
	bool "OPlus SDM710"
	depends on ARCH_QCOM
	select MACH_OPLUS
	help
	  Support for OPlus SDM710 devices

menu "OPlus board selection"

config MACH_OPLUS_PBEM00
  bool "OPPO R17 board"
  select MACH_OPLUS_SDM710
  help
    Support for OPPO R17 (PBEM00)

endmenu
```
